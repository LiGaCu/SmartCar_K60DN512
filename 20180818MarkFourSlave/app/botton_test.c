#include "common.h"
#include "botton_test.h"
#include "camera.h"
#include "oled.h"
#include "myflash.h"

void botton_init_gpio(void)
{  
  static GPIO_InitTypeDef botton_gpio_init;
  botton_gpio_init.GPIO_PTx = PTE;
  botton_gpio_init.GPIO_Pins = GPIO_Pin24|GPIO_Pin25|GPIO_Pin26|GPIO_Pin27;
  botton_gpio_init.GPIO_Dir = DIR_INPUT;
  botton_gpio_init.GPIO_PinControl =INPUT_PULL_UP;
  LPLD_GPIO_Init(botton_gpio_init);
}
void Key_delay()
{
	uint16 i, n;
	for (i = 0; i < 19000; i++)
	{
		for (n = 0; n < 50; n++)
		{
			asm("nop");
		}
	}
}
unsigned char KeyScan(void)
{
  if (PTE24_I == 0)
  {
    Key_delay();
    if (PTE24_I == 0)
    {
      return 1;
    }
  }
  else if (PTE25_I == 0)//6
  {
    Key_delay();
    if (PTE25_I == 0)
    {
      return 2;
    }
  }
  else if (PTE26_I == 0)//6
  {
    Key_delay();
    if (PTE26_I == 0)
    {
      return 3;
    }
  }
  
  else if (PTE27_I == 0)//1
  {
    Key_delay();
    if (PTE27_I == 0)
    {
      return 4;
    }
  }
  return 10;
}
/*------------------------吃火锅专用-----------------------------------*/
const unsigned char LoveHotpot[][60] = 
{
  {0x00,0x00,0x00,0x00,0x00,0x00,0x00,0x00,0x00,0x00,0x00,0x00,0x00,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0x02,0x02},
  {0x02,0x02,0x0E,0x0C,0x0C,0x0C,0x0C,0x3C,0x3C,0x30,0xC0,0xC0,0xC0,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0x00,0x00},
  {0x00,0x00,0x00,0x00,0x00,0x00,0x00,0x00,0x00,0x00,0x00,0x00,0x00,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0x00,0x00},
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  {0x08,0x04,0x45,0x45,0x5D,0x57,0x35,0x25,0x35,0x35,0x2D,0x45,0x45,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0x00,0x00}
};

//const unsigned char LoveHotpot[][60] = 
//{
//  {0x00,0x00,0x00,0x00,0x00,0x00,0x00,0x00,0x00,0x00,0x00,0x00,0x00,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0x02,0x02},
//  {0x02,0x02,0x04,0x04,0x04,0x04,0x08,0x08,0x08,0x10,0x10,0x20,0x20,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0x00,0x00},
//  {0x00,0x00,0x00,0x00,0x00,0x00,0x00,0x00,0x00,0x00,0x00,0x00,0x00,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0xE0,0x00},
//  {0x00,0x00,0x00,0x00,0x00,0x00,0x00,0x00,0x00,0x00,0x00,0x00,0x00,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0x00,0x00},
//  {0x00,0x00,0x00,0x00,0x00,0x00,0x00,0x00,0x00,0x00,0x00,0x00,0x00,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0xFF,0xF8},
//  {0x00,0x00,0x00,0x00,0x00,0x00,0x00,0x00,0x00,0x00,0x00,0x00,0x00,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0x00,0x00},
//  {0x00,0x00,0x00,0x00,0x00,0x00,0x00,0x00,0x00,0x00,0x00,0x00,0x00,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0xFF,0xFF},
//  {0xFF,0xF8,0xF0,0xE0,0xC0,0xC0,0x80,0x00,0x00,0x00,0x00,0x00,0x00,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0x00,0x00},
//  {0x00,0x00,0x00,0x00,0x00,0x00,0x00,0x00,0x00,0x00,0x00,0x00,0x00,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0x01,0x03},
//  {0x03,0x07,0x07,0x0F,0x0F,0x1F,0x1F,0x3F,0x3E,0x7C,0x78,0xF0,0xE0,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0x00,0x00},
//  {0x00,0x00,0x00,0x00,0x00,0x00,0x00,0x00,0x00,0x00,0x00,0x00,0x00,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0x00,0x00},
//  {0x00,0x00,0x00,0x00,0x00,0x00,0x00,0x00,0x00,0x00,0x00,0x00,0x00,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0x00,0x00},
//  {0x00,0x00,0x00,0x00,0x00,0x00,0x00,0x00,0x00,0x00,0x00,0x00,0x00,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0x40,0x40},
//  {0x40,0x40,0x20,0x20,0x20,0x20,0x10,0x10,0x10,0x08,0x08,0x04,0x04,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0x00,0x00}
//};
void LED_Forfun_Image_120_56(const unsigned char *p)
{
  uint8 i,j;
  for(j=0;j<7;j++)
  {
      LED_Set_Pos(0,j);    
      for(i=0;i<120;i++)
      {     
              LED_WrDat(*(p+i+j*120));  
      }
  }
}

/*------------------------按键设置--------------------------------------*/
uint8 pagenum=1,lastpage;

void setting_process(void)
{
  if(PTE24_I==1&&PTE25_I==1&&PTE26_I==1&&PTE27_I==1)
  {
    if(lastpage!=pagenum) LED_Fill(0);
    if(pagenum==1)
    {
       dis_bmp_half(ROW/2, COLUMN/2, Image2[0],setvalue);
       LED_PrintValueC(100 ,0,Barrier_x);
       LED_PrintValueC(100 ,1,Barrier_y);
       LED_PrintValueFP(100 ,2,Validfiguresize,3);
       LED_PrintValueC(100 ,4,setvalue);
       LED_PrintValueI(42, 7, (int) Variance);
       LED_PrintValueC(0, 7, (int) Several_signal_y);
       display_BarrierLine_80_50(-1.2000,45);
       display_BarrierLine_80_50(0.9333,-106);
    }
    else if(pagenum==2)
    {
       dis_bmp_half_two(ROW_Two/2, COLUMN_Two/2, ImageTwo2[0],setvalue_Two);
       LED_PrintValueC(100 ,0,real_pointx);
       LED_PrintValueC(100 ,1,real_pointy);
       LED_PrintValueC(100 ,4,RealNopoint);
    }
    else
    {
      if(lastpage!=3)
      LED_Forfun_Image_120_56(LoveHotpot[0]);
    }
    lastpage=pagenum;
  }
  else
  {
    unsigned char temp = 10;//此初值表示没有按键按下
    temp = KeyScan();
    switch(temp)
    {
      case 1: if(pagenum==1) pagenum=2;
              else if(pagenum==2) pagenum=3;
              else if(pagenum==3) pagenum=1;
              LPLD_LPTMR_DelayMs(200);
              break;
      case 2: flash_config();
              LED_Fill(0);
              LED_P6x8Str(42, 3,(unsigned char*)"Done!");
              LPLD_LPTMR_DelayMs(1000);
              LED_Fill(0);
              break;
      case 4: if(pagenum==1) 
              {
                setvalue+=2;
                if(setvalue>250) setvalue=250;
              }
              LPLD_LPTMR_DelayMs(100);
              break;
      case 3: if(pagenum==1) 
              {
                setvalue-=2;
                if(setvalue<5) setvalue=5;
              }
              LPLD_LPTMR_DelayMs(100);
              break;
    }
  }
}